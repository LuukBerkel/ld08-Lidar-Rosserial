/**
 * @file lds_08.cpp
 * @brief this file contains the results for the lds_08 driver on an for arduino.
 * @author Luuk van Berkel
 * @date 16-3-2023
 */
#include "ld08.hpp"
#include <stdio.h>
#include <stdlib.h>
#include <Arduino.h>

/// @brief this is the crc table that is used to validate the crc.
static const uint8_t crcTable[256] =
{
  0x00, 0x4d, 0x9a, 0xd7, 0x79, 0x34, 0xe3,
  0xae, 0xf2, 0xbf, 0x68, 0x25, 0x8b, 0xc6, 0x11, 0x5c, 0xa9, 0xe4, 0x33,
  0x7e, 0xd0, 0x9d, 0x4a, 0x07, 0x5b, 0x16, 0xc1, 0x8c, 0x22, 0x6f, 0xb8,
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  0x5a, 0x06, 0x4b, 0x9c, 0xd1, 0x7f, 0x32, 0xe5, 0xa8
};

bool ld08::validate_crc(uint8_t cmd_byte, uint8_t len_byte, uint8_t* buffer){
    if (buffer == nullptr) {
        return false;
    }

    uint8_t  calculated_crc = 0;
    calculated_crc = crcTable[(calculated_crc ^ cmd_byte) & 0xff];
    calculated_crc = crcTable[(calculated_crc ^ len_byte) & 0xff];
    for (uint32_t i = 0; i < len_byte-1; i++) {
      calculated_crc = crcTable[(calculated_crc^ buffer[i]) & 0xff];
    }

    if (buffer[len_byte-1] != calculated_crc){
      Serial.print(buffer[len_byte-1]);
      Serial.print(",");
      Serial.println(calculated_crc);
    }

    return buffer[len_byte-1] == calculated_crc;
}

void ld08::pwm_worker( void (*pwm_callback)(ld08_settings, int)){
  ld08::pwm_callback = pwm_callback;
}

void ld08::settings(int speed, int angle, int pwm_freq){
  ld08::lds_08_setting.speed =    speed;
  ld08::lds_08_setting.angle =    angle;
  ld08::lds_08_setting.pwm_freq = pwm_freq;
  if (ld08::pwm_callback != nullptr){
    ld08::pwm_callback(ld08::lds_08_setting, ld08::pwm_pin);
  }
}

uint16_t parse_to_uint16_t(uint8_t high, uint8_t low){
  uint16_t high_byte = high << 8; 
  uint16_t low_byte = low;
  return high_byte ^ low_byte;
}

// todo: uses angle setting to throw out invalid angle.
bool ld08::parse_buffer(ld08_frame* frame, uint8_t* buffer, int lenght){
  if (frame == nullptr || buffer == nullptr){
    return false;
  }

  frame->rotation_speed = parse_to_uint16_t(buffer[1], buffer[0]);
  frame->start_angle = parse_to_uint16_t(buffer[3], buffer[2]);
  frame->end_angle = parse_to_uint16_t(buffer[41], buffer[40]);
  frame->timestamp = parse_to_uint16_t(buffer[42], buffer[43]);

  for (uint32_t i = 0; i < 12; i++) {
    frame->data_buffer_ptr[i].distance =  parse_to_uint16_t(buffer[5+i*3], buffer[4+i*3]);
    frame->data_buffer_ptr[i].confidence =  buffer[6+i*3];
  }  

  return true;
}

bool ld08::read_frame(ld08_frame* frame){
  if (frame == nullptr){
    return false;
  }

  Serial.print("Bytes available: ");
  Serial.println(Serial2.available());
  while(Serial2.available() && Serial2.read() != 0x54);

  uint8_t lenght = Serial2.read();
  if (lenght != 44){
    return false;
  }
  Serial2.readBytes(ld08::raw_buffer_ptr, lenght);

  if(!ld08::parse_buffer(frame, ld08::raw_buffer_ptr, lenght)){
    Serial.println("Parsing failed");
    return false;
  }

  return true;
}

void ld08::begin(){
    Serial2.begin(115200, SERIAL_8N1, ld08::rx_pin);
}

ld08::ld08(int rx_pin, int pwm_pin){
  ld08::rx_pin = rx_pin;
  ld08::pwm_pin = pwm_pin;


}

ld08::~ld08(){}